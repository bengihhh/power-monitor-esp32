## sdkconfig.defaults
```kconfig
CONFIG_BSP_LCD_SUB_BOARD_800_480=y
CONFIG_SPIRAM=y
CONFIG_SPIRAM_MODE_OCT=y
CONFIG_SPIRAM_SPEED_80M=y
CONFIG_ESPTOOLPY_FLASHSIZE_16MB=y
CONFIG_ESP_CONSOLE_UART_CUSTOM=y
CONFIG_ESP_CONSOLE_UART_BAUDRATE=921600
CONFIG_LOG_DEFAULT_LEVEL_WARN=y
CONFIG_ESP_CONSOLE_SECONDARY_NONE=y
CONFIG_BSP_LCD_RGB_BOUNCE_BUFFER_MODE=y
# CONFIG_LCD_RGB_RESTART_IN_VSYNC is not set
CONFIG_BSP_DISPLAY_LVGL_BUF_HEIGHT=32
CONFIG_BSP_LCD_RGB_BUFFER_NUMS=2
CONFIG_BSP_DISPLAY_LVGL_AVOID_TEAR=y
CONFIG_BSP_DISPLAY_LVGL_DIRECT_MODE=y
CONFIG_BSP_LCD_RGB_BOUNCE_BUFFER_HEIGHT=20
CONFIG_ESP_DEFAULT_CPU_FREQ_MHZ_240=y
CONFIG_ESP32S3_DATA_CACHE_LINE_64B=y
CONFIG_COMPILER_OPTIMIZATION_PERF=y

CONFIG_LV_FONT_MONTSERRAT_22=y

CONFIG_LV_FONT_MONTSERRAT_26=y
```
